## main/Kconfig.projbuild
```kconfig
menu "Application Configuration"

	config ESP_WIFI_SSID
		string "WiFi SSID"
		default "myssid"
		help
			SSID (network name) for the example to connect to.

	config ESP_WIFI_PASSWORD
		string "WiFi Password"
		default "mypassword"
		help
			WiFi password (WPA or WPA2) for the example to use.

	config ESP_MAXIMUM_RETRY
		int "Maximum retry"
		default 5
		help
			Set the Maximum retry to avoid station reconnecting to the AP unlimited when the AP is really inexistent.

	config ESP_MPD_SERVER
		string "IP address or mDNS of MPD Server"
		default "mpd-server.local"
		help
			IP address or mDNS of MPD Server.

	choice ESP_FONT
		bool "Select font"
		default ESP_FONT_GOTHIC
		help
			Select font.

		config ESP_FONT_GOTHIC
			bool "Gothic"
		config ESP_FONT_MINCYO
			bool "Mincyo"
	endchoice

	config ENCODER
		bool "Enable incremental rotary encoder as volume"
		default false
		help
			Enable incremental rotary encoder as volume.
			GPIO number to Encoder Phase A is GPIO21.
			GPIO number to Encoder Phase B is GPIO22.

endmenu
```
